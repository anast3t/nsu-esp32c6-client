## components/transport/Kconfig
```kconfig
menu "Transport configuration"

config PROTO_BT_ENABLED
    bool "Use BLE transport"
    default n
    help
      Если включено, будет собираться transport_ble.c.
      Если выключено — transport_wifi.c.

endmenu
```

## sdkconfig.defaults
```kconfig
CONFIG_BLINK_LED_GPIO=y
CONFIG_BLINK_GPIO=8
CONFIG_BT_ENABLED=y
CONFIG_BT_CONTROLLER_ENABLED=y
CONFIG_BT_BLE_ENABLED=y
CONFIG_BT_NIMBLE_ENABLED=y
CONFIG_BT_NIMBLE_ROLE_CENTRAL=y
CONFIG_BT_NIMBLE_ROLE_PERIPHERAL=y
CONFIG_BT_NIMBLE_50_FEATURE_SUPPORT=n
```
